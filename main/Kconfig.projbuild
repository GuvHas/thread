## main/Kconfig.projbuild
```kconfig
menu "Matter device options"

config MATTER_NODE_LABEL
    string "Default Matter Node Label"
    default "XIAO-ESP32C6"
    help
        Human-friendly node name shown by commissioner apps.
        This value can still be changed later from Matter commissioning tools.

endmenu
```

## sdkconfig.defaults
```kconfig
CONFIG_IDF_TARGET="esp32c6"

# Matter / OpenThread
CONFIG_ENABLE_WIFI_STATION=n
CONFIG_OPENTHREAD_ENABLED=y
CONFIG_OPENTHREAD_BORDER_ROUTER=n
CONFIG_OPENTHREAD_FTD=y
CONFIG_OPENTHREAD_RADIO_NATIVE=y
CONFIG_CHIP_OPENTHREAD_FTD=y
CONFIG_CHIP_DEVICE_TYPE="rootnode"

# Pairing / discovery
CONFIG_USE_BLE_ONLY_FOR_COMMISSIONING=y
CONFIG_BT_ENABLED=y
CONFIG_BT_BLE_ENABLED=y

# USB power scenario (no deep sleep assumptions)
CONFIG_PM_ENABLE=n
```
